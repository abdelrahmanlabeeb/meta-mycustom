## conf/layer.conf
```bitbake
# We have a conf and classes directory, add to BBPATH
BBPATH .= ":${LAYERDIR}"

# We have recipes-* directories, add to BBFILES
BBFILES += "${LAYERDIR}/recipes-*/*/*.bb \
            ${LAYERDIR}/recipes-*/*/*.bbappend"

BBFILE_COLLECTIONS += "meta-mycustom"
BBFILE_PATTERN_meta-mycustom = "^${LAYERDIR}/"
BBFILE_PRIORITY_meta-mycustom = "6"

LAYERDEPENDS_meta-mycustom = "core"
LAYERSERIES_COMPAT_meta-mycustom = "scarthgap"
```
